## my_uboot/board/freescale/mx6ull_alientek_emmc/Kconfig
```kconfig
 # 添加开发板对应的板级文件夹，是该目录下的整个文件夹的修改
 # 本文件为修改的Kconfig文件

if TARGET_MX6ULL_ALIENTEK_EMMC

config SYS_BOARD
	default "mx6ull_alientek_emmc"

config SYS_VENDOR
	default "freescale"

config SYS_SOC
	default "max6"

config SYS_CONFIG_NAME
	default "mx6ull_alientek_emmc"

endif
```
